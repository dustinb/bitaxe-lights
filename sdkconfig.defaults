## sdkconfig.defaults
```kconfig
CONFIG_IDF_TARGET="esp32"
CONFIG_IDF_TARGET_ESP32=y
CONFIG_ESP_TLS_INSECURE=y
CONFIG_ESP_HTTP_CLIENT_ENABLE_WEBSOCKET=y
CONFIG_HTTPD_MAX_RESP_HEADERS=16
CONFIG_HTTPD_MAX_URI_LEN=512
CONFIG_HTTPD_MAX_REQ_HDR_LEN=1024
CONFIG_HTTPD_PURGE_BUF_LEN=32
```
